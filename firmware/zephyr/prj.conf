## CMakeLists.txt
```
cmake_minimum_required(VERSION 3.20.0)
find_package(Zephyr REQUIRED HINTS $ENV{ZEPHYR_BASE})
project(civixrecord_ble_edge_firmware)

target_sources(app PRIVATE
    src/main.c
    src/ble_audio_service.c
    src/optical_glasses_service.c
    src/pen_digitizer_service.c
)

target_include_directories(app PRIVATE include)
```

## prj.conf
```kconfig
# CivixRecord Edge Firmware Kernel Configuration
# Platform: Nordic Semiconductor nRF5340 / nRF52840 SoC

# Bluetooth Low Energy Stack
CONFIG_BT=y
CONFIG_BT_PERIPHERAL=y
CONFIG_BT_DEVICE_NAME="CivixRecord-Sensor"
CONFIG_BT_DEVICE_APPEARANCE=833
CONFIG_BT_MAX_CONN=2
CONFIG_BT_BUF_ACL_RX_SIZE=255
CONFIG_BT_BUF_ACL_TX_SIZE=255

# BLE Audio & Isochronous Channels (LC3 Codec)
CONFIG_BT_AUDIO=y
CONFIG_BT_BAP_UNICAST_SERVER=y
CONFIG_BT_ASCS=y
CONFIG_BT_PAC_SNK=y

# PDM Microphone Audio Capture
CONFIG_AUDIO=y
CONFIG_AUDIO_DMIC=y
CONFIG_NRFX_PDM=y

# Power Management & Logging
CONFIG_PM_DEVICE=y
CONFIG_LOG=y
CONFIG_LOG_DEFAULT_LEVEL=3
CONFIG_MAIN_STACK_SIZE=4096
CONFIG_SYSTEM_WORKQUEUE_STACK_SIZE=2048
```

## src/main.c
```c
/*
 * CivixRecord Edge Firmware - Nordic nRF5340 / nRF52840 Entrypoint
 * Autonomous civic meeting acoustic capture & multi-sensor hardware mesh
 */

#include <zephyr/kernel.h>
#include <zephyr/logging/log.h>
#include <zephyr/bluetooth/bluetooth.h>
#include <zephyr/bluetooth/gap.h>

#include "ble_audio_service.h"
#include "optical_glasses_service.h"
#include "pen_digitizer_service.h"

LOG_MODULE_REGISTER(civix_edge, LOG_LEVEL_INF);

static const struct bt_data ad[] = {
    BT_DATA_BYTES(BT_DATA_FLAGS, (BT_LE_AD_GENERAL | BT_LE_AD_NO_BREDR)),
    BT_DATA(BT_DATA_NAME_COMPLETE, "CivixRecord-Sensor", 18),
};

static void bt_ready(int err) {
    if (err) {
        LOG_ERR("Bluetooth initialization failed (err %d)", err);
        return;
    }

    LOG_INF("Bluetooth initialized successfully");

    err = civix_ble_audio_service_init();
    if (err) {
        LOG_ERR("Failed to register Civix Audio GATT service (err %d)", err);
        return;
    }

    err = civix_glasses_service_init();
    if (err) {
        LOG_ERR("Failed to register Civix Optical Glasses GATT service (err %d)", err);
        return;
    }

    err = civix_pen_service_init();
    if (err) {
        LOG_ERR("Failed to register Civix Pen Digitizer GATT service (err %d)", err);
        return;
    }

    err = bt_le_adv_start(BT_LE_ADV_CONN_NAME, ad, ARRAY_SIZE(ad), NULL, 0);
    if (err) {
        LOG_ERR("Advertising failed to start (err %d)", err);
        return;
    }

    LOG_INF("BLE Advertising started. Multi-sensor mesh listening for CivixRecord Core connection.");
}

int main(void) {
    LOG_INF("CivixRecord Edge Hardware Firmware v0.4.1 booting...");

    int err = bt_enable(bt_ready);
    if (err) {
        LOG_ERR("bt_enable failed (err %d)", err);
        return 0;
    }

    while (1) {
        k_sleep(K_SECONDS(1));
    }

    return 0;
}
```

## include/ble_audio_service.h
```c
#pragma once

#include <zephyr/types.h>
#include <zephyr/bluetooth/bluetooth.h>
#include <zephyr/bluetooth/conn.h>
#include <zephyr/bluetooth/uuid.h>
#include <zephyr/bluetooth/gatt.h>

#ifdef __cplusplus
extern "C" {
#endif

/* 128-bit Base UUID for CivixRecord Civic Audio GATT Service:
 * 9E110001-C141-4E65-B801-D48293817100
 */
#define BT_UUID_CIVIX_VAL \
    BT_UUID_128_ENCODE(0x9E110001, 0xC141, 0x4E65, 0xB801, 0xD48293817100)

#define BT_UUID_CIVIX_AUDIO_STREAM_VAL \
    BT_UUID_128_ENCODE(0x9E110002, 0xC141, 0x4E65, 0xB801, 0xD48293817100)

#define BT_UUID_CIVIX_TELEMETRY_VAL \
    BT_UUID_128_ENCODE(0x9E110003, 0xC141, 0x4E65, 0xB801, 0xD48293817100)

int civix_ble_audio_service_init(void);
int civix_ble_send_audio_packet(const uint8_t *data, uint16_t len);

#ifdef __cplusplus
}
#endif
```

## include/optical_glasses_service.h
```c
#pragma once

#include <zephyr/types.h>
#include <zephyr/bluetooth/bluetooth.h>
#include <zephyr/bluetooth/conn.h>
#include <zephyr/bluetooth/uuid.h>
#include <zephyr/bluetooth/gatt.h>

#ifdef __cplusplus
extern "C" {
#endif

/* 128-bit Base UUID for CivixRecord Optical Glasses Service (Opcode 0x61):
 * 9E110061-C141-4E65-B801-D48293817100
 */
#define BT_UUID_CIVIX_GLASSES_VAL \
    BT_UUID_128_ENCODE(0x9E110061, 0xC141, 0x4E65, 0xB801, 0xD48293817100)

/* Characteristic: Frame Rate & Shutter Timing Sync */
#define BT_UUID_CIVIX_GLASSES_SYNC_VAL \
    BT_UUID_128_ENCODE(0x9E110062, 0xC141, 0x4E65, 0xB801, 0xD48293817100)

/* Characteristic: Zero-Copy Frame Event Stream */
#define BT_UUID_CIVIX_GLASSES_EVENT_VAL \
    BT_UUID_128_ENCODE(0x9E110063, 0xC141, 0x4E65, 0xB801, 0xD48293817100)

/* Characteristic: Gaze Alignment & Optical Sensor Telemetry */
#define BT_UUID_CIVIX_GLASSES_TELEMETRY_VAL \
    BT_UUID_128_ENCODE(0x9E110064, 0xC141, 0x4E65, 0xB801, 0xD48293817100)

#pragma pack(push, 1)
struct civix_glasses_sync_cfg {
    uint32_t fps;           /* Target optical capture rate (fps) */
    uint32_t shutter_us;    /* Exposure shutter duration in microseconds */
    uint8_t flags;          /* Bit 0: Continuous sync, Bit 1: Strobe lock */
};

struct civix_glasses_frame_event {
    uint32_t frame_index;   /* Monotonic camera frame counter */
    uint32_t timestamp_us;  /* Sensor exposure timestamp */
    uint16_t exposure_us;   /* Actual integration period */
    uint8_t strobe_state;   /* IR illuminator / LED sync pulse status */
};

struct civix_glasses_telemetry {
    int16_t gaze_x;         /* Normalized eye tracking X (-1000..+1000) */
    int16_t gaze_y;         /* Normalized eye tracking Y (-1000..+1000) */
    int16_t imu_pitch;      /* IMU pitch angle in 0.1 deg */
    int16_t imu_yaw;        /* IMU yaw angle in 0.1 deg */
    uint8_t optical_lock;   /* 1 = Fixated, 0 = Saccade */
    uint8_t battery_pct;    /* Hardware battery percentage (0-100) */
};
#pragma pack(pop)

int civix_glasses_service_init(void);
int civix_glasses_update_sync_config(uint32_t fps, uint32_t shutter_us, uint8_t flags);
int civix_glasses_send_frame_sync(const struct civix_glasses_frame_event *event);
int civix_glasses_send_telemetry(const struct civix_glasses_telemetry *telemetry);
int civix_glasses_get_sync_config(struct civix_glasses_sync_cfg *cfg);

#ifdef __cplusplus
}
#endif
```

## include/pen_digitizer_service.h
```c
#pragma once

#include <zephyr/types.h>
#include <zephyr/bluetooth/bluetooth.h>
#include <zephyr/bluetooth/conn.h>
#include <zephyr/bluetooth/uuid.h>
#include <zephyr/bluetooth/gatt.h>

#ifdef __cplusplus
extern "C" {
#endif

/* 128-bit Base UUID for CivixRecord Ultrasonic Acoustic Pen Digitizer (Opcode 0x62):
 * 9E110070-C141-4E65-B801-D48293817100
 */
#define BT_UUID_CIVIX_PEN_VAL \
    BT_UUID_128_ENCODE(0x9E110070, 0xC141, 0x4E65, 0xB801, 0xD48293817100)

/* Characteristic: High-Rate Acoustic Stroke Coordinate Stream */
#define BT_UUID_CIVIX_PEN_STROKE_VAL \
    BT_UUID_128_ENCODE(0x9E110071, 0xC141, 0x4E65, 0xB801, 0xD48293817100)

/* Characteristic: Digitizer Resolution (DPI) & Sampling Configuration */
#define BT_UUID_CIVIX_PEN_CONFIG_VAL \
    BT_UUID_128_ENCODE(0x9E110072, 0xC141, 0x4E65, 0xB801, 0xD48293817100)

/* Characteristic: Ultrasonic Time-of-Flight & Transducer Telemetry */
#define BT_UUID_CIVIX_PEN_TELEMETRY_VAL \
    BT_UUID_128_ENCODE(0x9E110073, 0xC141, 0x4E65, 0xB801, 0xD48293817100)

#pragma pack(push, 1)
struct civix_pen_config {
    uint32_t dpi;              /* Digitizer resolution: 600, 1200, 2400 */
    uint16_t sample_rate_hz;   /* Acoustic pulse rate: 100-500 Hz */
    uint8_t  pressure_levels;  /* 0 = 2048, 1 = 4096, 2 = 8192 levels */
    uint8_t  active_mode;      /* 0 = Low-power standby, 1 = Continuous tracking */
};

struct civix_pen_stroke_sample {
    uint32_t timestamp_us;     /* Microsecond sampling timestamp */
    int32_t  pos_x;            /* X coordinate in micrometers */
    int32_t  pos_y;            /* Y coordinate in micrometers */
    uint16_t pressure;         /* Tip pressure reading (0-8191) */
    int16_t  tilt_x;           /* Acoustic tilt X in 0.1 deg */
    int16_t  tilt_y;           /* Acoustic tilt Y in 0.1 deg */
    uint8_t  button_flags;     /* Bit 0: Tip contact, Bit 1: Barrel button */
    uint8_t  proximity;        /* 0 = Surface contact, 1 = Proximity hover */
};

struct civix_pen_telemetry {
    uint16_t ultrasonic_snr_db;  /* Acoustic SNR in 0.1 dB */
    uint16_t tof_delta_ns;       /* Differential time of flight in ns */
    uint8_t  transducer_health;  /* Piezo transducer health check (0-100) */
    uint8_t  battery_pct;        /* Stylus battery state of charge (0-100) */
};
#pragma pack(pop)

int civix_pen_service_init(void);
int civix_pen_send_stroke(const struct civix_pen_stroke_sample *sample);
int civix_pen_update_config(uint32_t dpi, uint16_t sample_rate_hz, uint8_t pressure_levels, uint8_t active_mode);
int civix_pen_send_telemetry(const struct civix_pen_telemetry *telemetry);
int civix_pen_get_config(struct civix_pen_config *cfg);

#ifdef __cplusplus
}
#endif
```

## src/ble_audio_service.c
```c
#include "ble_audio_service.h"
#include <zephyr/logging/log.h>

LOG_MODULE_REGISTER(civix_gatt, LOG_LEVEL_INF);

static struct bt_uuid_128 civix_uuid = BT_UUID_INIT_128(BT_UUID_CIVIX_VAL);
static struct bt_uuid_128 audio_stream_uuid = BT_UUID_INIT_128(BT_UUID_CIVIX_AUDIO_STREAM_VAL);
static struct bt_uuid_128 telemetry_uuid = BT_UUID_INIT_128(BT_UUID_CIVIX_TELEMETRY_VAL);

static uint8_t telemetry_buf[16] = {0};

static ssize_t read_telemetry(struct bt_conn *conn, const struct bt_gatt_attr *attr,
                              void *buf, uint16_t len, uint16_t offset) {
    return bt_gatt_attr_read(conn, attr, buf, len, offset, telemetry_buf, sizeof(telemetry_buf));
}

BT_GATT_SERVICE_DEFINE(civix_svc,
    BT_GATT_PRIMARY_SERVICE(&civix_uuid),
    BT_GATT_CHARACTERISTIC(&audio_stream_uuid.uuid,
                           BT_GATT_CHRC_NOTIFY,
                           BT_GATT_PERM_NONE,
                           NULL, NULL, NULL),
    BT_GATT_CCC(NULL, BT_GATT_PERM_READ | BT_GATT_PERM_WRITE),
    BT_GATT_CHARACTERISTIC(&telemetry_uuid.uuid,
                           BT_GATT_CHRC_READ | BT_GATT_CHRC_NOTIFY,
                           BT_GATT_PERM_READ,
                           read_telemetry, NULL, telemetry_buf),
);

int civix_ble_audio_service_init(void) {
    LOG_INF("CivixRecord Custom 128-bit GATT Service Registered");
    return 0;
}

int civix_ble_send_audio_packet(const uint8_t *data, uint16_t len) {
    return bt_gatt_notify(NULL, &civix_svc.attrs[1], data, len);
}
```

## src/optical_glasses_service.c
```c
#include "optical_glasses_service.h"

#include <zephyr/logging/log.h>
#include <string.h>

LOG_MODULE_REGISTER(civix_glasses, LOG_LEVEL_INF);

static struct bt_uuid_128 glasses_svc_uuid = BT_UUID_INIT_128(BT_UUID_CIVIX_GLASSES_VAL);
static struct bt_uuid_128 glasses_sync_uuid = BT_UUID_INIT_128(BT_UUID_CIVIX_GLASSES_SYNC_VAL);
static struct bt_uuid_128 glasses_event_uuid = BT_UUID_INIT_128(BT_UUID_CIVIX_GLASSES_EVENT_VAL);
static struct bt_uuid_128 glasses_telem_uuid = BT_UUID_INIT_128(BT_UUID_CIVIX_GLASSES_TELEMETRY_VAL);

static struct civix_glasses_sync_cfg current_sync_cfg = {
    .fps = 30,
    .shutter_us = 1000,
    .flags = 0x01,
};

static struct civix_glasses_telemetry current_telemetry = {
    .gaze_x = 0,
    .gaze_y = 0,
    .imu_pitch = 0,
    .imu_yaw = 0,
    .optical_lock = 0,
    .battery_pct = 100,
};

static ssize_t read_sync_cfg(struct bt_conn *conn, const struct bt_gatt_attr *attr,
                             void *buf, uint16_t len, uint16_t offset) {
    return bt_gatt_attr_read(conn, attr, buf, len, offset,
                             &current_sync_cfg, sizeof(current_sync_cfg));
}

static ssize_t write_sync_cfg(struct bt_conn *conn, const struct bt_gatt_attr *attr,
                              const void *buf, uint16_t len, uint16_t offset,
                              uint8_t flags) {
    if (offset + len > sizeof(current_sync_cfg)) {
        return BT_GATT_ERR(BT_ATT_ERR_INVALID_OFFSET);
    }
    memcpy((uint8_t *)&current_sync_cfg + offset, buf, len);
    LOG_INF("Optical Glasses Sync Updated: FPS=%u, Shutter=%u us, Flags=0x%02X",
            current_sync_cfg.fps, current_sync_cfg.shutter_us, current_sync_cfg.flags);
    return len;
}

static ssize_t read_telemetry(struct bt_conn *conn, const struct bt_gatt_attr *attr,
                              void *buf, uint16_t len, uint16_t offset) {
    return bt_gatt_attr_read(conn, attr, buf, len, offset,
                             &current_telemetry, sizeof(current_telemetry));
}

BT_GATT_SERVICE_DEFINE(civix_glasses_svc,
    BT_GATT_PRIMARY_SERVICE(&glasses_svc_uuid),
    BT_GATT_CHARACTERISTIC(&glasses_sync_uuid.uuid,
                           BT_GATT_CHRC_READ | BT_GATT_CHRC_WRITE | BT_GATT_CHRC_NOTIFY,
                           BT_GATT_PERM_READ | BT_GATT_PERM_WRITE,
                           read_sync_cfg, write_sync_cfg, &current_sync_cfg),
    BT_GATT_CCC(NULL, BT_GATT_PERM_READ | BT_GATT_PERM_WRITE),
    BT_GATT_CHARACTERISTIC(&glasses_event_uuid.uuid,
                           BT_GATT_CHRC_NOTIFY,
                           BT_GATT_PERM_NONE,
                           NULL, NULL, NULL),
    BT_GATT_CCC(NULL, BT_GATT_PERM_READ | BT_GATT_PERM_WRITE),
    BT_GATT_CHARACTERISTIC(&glasses_telem_uuid.uuid,
                           BT_GATT_CHRC_READ | BT_GATT_CHRC_NOTIFY,
                           BT_GATT_PERM_READ,
                           read_telemetry, NULL, &current_telemetry),
    BT_GATT_CCC(NULL, BT_GATT_PERM_READ | BT_GATT_PERM_WRITE),
);

int civix_glasses_service_init(void) {
    LOG_INF("CivixRecord Optical Glasses Sync GATT Service Initialized (Opcode 0x61)");
    return 0;
}

int civix_glasses_update_sync_config(uint32_t fps, uint32_t shutter_us, uint8_t flags) {
    current_sync_cfg.fps = fps;
    current_sync_cfg.shutter_us = shutter_us;
    current_sync_cfg.flags = flags;
    return bt_gatt_notify(NULL, &civix_glasses_svc.attrs[1], &current_sync_cfg, sizeof(current_sync_cfg));
}

int civix_glasses_send_frame_sync(const struct civix_glasses_frame_event *event) {
    if (!event) {
        return -EINVAL;
    }
    return bt_gatt_notify(NULL, &civix_glasses_svc.attrs[4], event, sizeof(*event));
}

int civix_glasses_send_telemetry(const struct civix_glasses_telemetry *telemetry) {
    if (!telemetry) {
        return -EINVAL;
    }
    memcpy(&current_telemetry, telemetry, sizeof(current_telemetry));
    return bt_gatt_notify(NULL, &civix_glasses_svc.attrs[7], &current_telemetry, sizeof(current_telemetry));
}

int civix_glasses_get_sync_config(struct civix_glasses_sync_cfg *cfg) {
    if (!cfg) {
        return -EINVAL;
    }
    memcpy(cfg, &current_sync_cfg, sizeof(*cfg));
    return 0;
}
```

## src/pen_digitizer_service.c
```c
#include "pen_digitizer_service.h"

#include <zephyr/logging/log.h>
#include <string.h>

LOG_MODULE_REGISTER(civix_pen, LOG_LEVEL_INF);

static struct bt_uuid_128 pen_svc_uuid = BT_UUID_INIT_128(BT_UUID_CIVIX_PEN_VAL);
static struct bt_uuid_128 pen_stroke_uuid = BT_UUID_INIT_128(BT_UUID_CIVIX_PEN_STROKE_VAL);
static struct bt_uuid_128 pen_config_uuid = BT_UUID_INIT_128(BT_UUID_CIVIX_PEN_CONFIG_VAL);
static struct bt_uuid_128 pen_telem_uuid = BT_UUID_INIT_128(BT_UUID_CIVIX_PEN_TELEMETRY_VAL);

static struct civix_pen_config current_pen_config = {
    .dpi = 1200,
    .sample_rate_hz = 200,
    .pressure_levels = 1,
    .active_mode = 1,
};

static struct civix_pen_telemetry current_pen_telemetry = {
    .ultrasonic_snr_db = 420,
    .tof_delta_ns = 12,
    .transducer_health = 100,
    .battery_pct = 95,
};

static ssize_t read_pen_cfg(struct bt_conn *conn, const struct bt_gatt_attr *attr,
                            void *buf, uint16_t len, uint16_t offset) {
    return bt_gatt_attr_read(conn, attr, buf, len, offset,
                             &current_pen_config, sizeof(current_pen_config));
}

static ssize_t write_pen_cfg(struct bt_conn *conn, const struct bt_gatt_attr *attr,
                             const void *buf, uint16_t len, uint16_t offset,
                             uint8_t flags) {
    if (offset + len > sizeof(current_pen_config)) {
        return BT_GATT_ERR(BT_ATT_ERR_INVALID_OFFSET);
    }
    memcpy((uint8_t *)&current_pen_config + offset, buf, len);
    LOG_INF("Pen Digitizer Config Updated: DPI=%u, SampleRate=%u Hz, Mode=%u",
            current_pen_config.dpi, current_pen_config.sample_rate_hz, current_pen_config.active_mode);
    return len;
}

static ssize_t read_pen_telemetry(struct bt_conn *conn, const struct bt_gatt_attr *attr,
                                  void *buf, uint16_t len, uint16_t offset) {
    return bt_gatt_attr_read(conn, attr, buf, len, offset,
                             &current_pen_telemetry, sizeof(current_pen_telemetry));
}

BT_GATT_SERVICE_DEFINE(civix_pen_svc,
    BT_GATT_PRIMARY_SERVICE(&pen_svc_uuid),
    BT_GATT_CHARACTERISTIC(&pen_stroke_uuid.uuid,
                           BT_GATT_CHRC_NOTIFY,
                           BT_GATT_PERM_NONE,
                           NULL, NULL, NULL),
    BT_GATT_CCC(NULL, BT_GATT_PERM_READ | BT_GATT_PERM_WRITE),
    BT_GATT_CHARACTERISTIC(&pen_config_uuid.uuid,
                           BT_GATT_CHRC_READ | BT_GATT_CHRC_WRITE | BT_GATT_CHRC_NOTIFY,
                           BT_GATT_PERM_READ | BT_GATT_PERM_WRITE,
                           read_pen_cfg, write_pen_cfg, &current_pen_config),
    BT_GATT_CCC(NULL, BT_GATT_PERM_READ | BT_GATT_PERM_WRITE),
    BT_GATT_CHARACTERISTIC(&pen_telem_uuid.uuid,
                           BT_GATT_CHRC_READ | BT_GATT_CHRC_NOTIFY,
                           BT_GATT_PERM_READ,
                           read_pen_telemetry, NULL, &current_pen_telemetry),
    BT_GATT_CCC(NULL, BT_GATT_PERM_READ | BT_GATT_PERM_WRITE),
);

int civix_pen_service_init(void) {
    LOG_INF("CivixRecord Ultrasonic Acoustic Pen Digitizer GATT Service Initialized (Opcode 0x62)");
    return 0;
}

int civix_pen_send_stroke(const struct civix_pen_stroke_sample *sample) {
    if (!sample) {
        return -EINVAL;
    }
    return bt_gatt_notify(NULL, &civix_pen_svc.attrs[1], sample, sizeof(*sample));
}

int civix_pen_update_config(uint32_t dpi, uint16_t sample_rate_hz, uint8_t pressure_levels, uint8_t active_mode) {
    current_pen_config.dpi = dpi;
    current_pen_config.sample_rate_hz = sample_rate_hz;
    current_pen_config.pressure_levels = pressure_levels;
    current_pen_config.active_mode = active_mode;
    return bt_gatt_notify(NULL, &civix_pen_svc.attrs[4], &current_pen_config, sizeof(current_pen_config));
}

int civix_pen_send_telemetry(const struct civix_pen_telemetry *telemetry) {
    if (!telemetry) {
        return -EINVAL;
    }
    memcpy(&current_pen_telemetry, telemetry, sizeof(current_pen_telemetry));
    return bt_gatt_notify(NULL, &civix_pen_svc.attrs[7], &current_pen_telemetry, sizeof(current_pen_telemetry));
}

int civix_pen_get_config(struct civix_pen_config *cfg) {
    if (!cfg) {
        return -EINVAL;
    }
    memcpy(cfg, &current_pen_config, sizeof(*cfg));
    return 0;
}
```
